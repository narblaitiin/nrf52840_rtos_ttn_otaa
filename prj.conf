## CMakeLists.txt
```
cmake_minimum_required(VERSION 3.20.0)

find_package(Zephyr REQUIRED HINTS $ENV{ZEPHYR_BASE})
project(nrf52840_rtos_ttn_otaa)

FILE(GLOB app_sources src/*.c)
target_sources(app PRIVATE ${app_sources})
```

## prj.conf
```kconfig
# Debugger Support
CONFIG_CONSOLE=y
CONFIG_SERIAL=y
CONFIG_UART_CONSOLE=n

# RTT Segger Support
CONFIG_RTT_CONSOLE=y
CONFIG_USE_SEGGER_RTT=y

# Communication Bus Support
CONFIG_GPIO=y
CONFIG_SPI=y

# LoRa Support
CONFIG_LORA=y

# LoRaWAN Support
CONFIG_LORAWAN=y
CONFIG_HAS_SEMTECH_LORAMAC=y
CONFIG_LORAMAC_REGION_EU868=y
CONFIG_LORAWAN_SYSTEM_MAX_RX_ERROR=100

# Flash Memory Support
CONFIG_NVS=y
CONFIG_FLASH=y
CONFIG_FLASH_PAGE_LAYOUT=y
CONFIG_MPU_ALLOW_FLASH_WRITE=y

# Stack Support
CONFIG_MAIN_STACK_SIZE=2048
CONFIG_SYSTEM_WORKQUEUE_STACK_SIZE=2048

# Random Number Generation Support
CONFIG_TEST_RANDOM_GENERATOR=y
```

## src/main.c
```c
/*
 * Copyright (c) 2025
 * Regis Rousseau
 * Univ Lyon, INSA Lyon, Inria, CITI, EA3720
 * SPDX-License-Identifier: Apache-2.0
 */

//  ========== includes ====================================================================
#include "app_lorawan.h"
#include "app_rtc.h"

//  ========== globals =====================================================================
// define GPIO specifications for the LEDs used to indicate transmission (TX) and reception (RX)
static const struct gpio_dt_spec led_tx = GPIO_DT_SPEC_GET(LED_TX, gpios);
static const struct gpio_dt_spec led_rx = GPIO_DT_SPEC_GET(LED_RX, gpios);
static void dl_callback(uint8_t port, bool data_pending,
			int16_t rssi, int8_t snr,
			uint8_t len, const uint8_t *hex_data)
{
	printk("Port %d, Pending %d, RSSI %ddB, SNR %ddBm", port, data_pending, rssi, snr);
	// if (hex_data) {
	// 	printk(hex_data, len, "Payload: ");
	// }
}

static void lorwan_datarate_changed(enum lorawan_datarate dr)
{
	uint8_t unused, max_size;

	lorawan_get_payload_sizes(&unused, &max_size);
	printk("New Datarate: DR_%d, Max Payload %d", dr, max_size);
}

//  ========== main ========================================================================
int8_t main(void)
{
	uint8_t payload[PAYLOAD_SIZE] = {0};
	int8_t ret;

	// structure to hold simulated sensor data
	struct data_t {
		int32_t timestamp;
		int16_t vbat;  // battery voltage in millivolts
		int16_t temp;  // temperature in tenths of a degree Celsius
		int16_t hum;   // humidity as a percentage
		int16_t vadc;  // ADC voltage in millivolts
	} data;

	// configure LEDs for TX and RX indication
	gpio_pin_configure_dt(&led_tx, GPIO_OUTPUT_ACTIVE);
	gpio_pin_configure_dt(&led_rx, GPIO_OUTPUT_ACTIVE);
	gpio_pin_set_dt(&led_tx, 0);		// turn off TX LED
	gpio_pin_set_dt(&led_rx, 0);		// turn off TX LED

	// initialize LoRaWAN protocol and register the device
	// ret = app_lorawan_init();
	// if (ret != 1) {
	// 	printk("failed to initialze LoRaWAN protocol\n");
	// 	return 0;
	// }

	const struct device *lora_dev;
	struct lorawan_join_config join_cfg;
	uint8_t dev_eui[] = LORAWAN_DEV_EUI;
	uint8_t join_eui[] = LORAWAN_JOIN_EUI;
	uint8_t app_key[] = LORAWAN_APP_KEY;

	struct lorawan_downlink_cb downlink_cb = {
		.port = LW_RECV_PORT_ANY,
		.cb = dl_callback
	};

	lora_dev = DEVICE_DT_GET(DT_ALIAS(lora0));
	if (!device_is_ready(lora_dev)) {
		printk("%s: device not ready.", lora_dev->name);
		return 0;
	}

	ret = lorawan_start();
	if (ret < 0) {
		printk("lorawan_start failed: %d", ret);
		return 0;
	}

	lorawan_register_downlink_callback(&downlink_cb);
	lorawan_register_dr_changed_callback(lorwan_datarate_changed);

	join_cfg.mode = LORAWAN_ACT_OTAA;
	join_cfg.dev_eui = dev_eui;
	join_cfg.otaa.join_eui = join_eui;
	join_cfg.otaa.app_key = app_key;
	join_cfg.otaa.nwk_key = app_key;
	join_cfg.otaa.dev_nonce = 0u;

	printk("Joining network over OTAA");
	ret = lorawan_join(&join_cfg);
	if (ret < 0) {
		printk("lorawan_join_network failed: %d", ret);
		return 0;
	}

	// initialize DS3231 RTC device via I2C (Pins: SDA -> P0.09, SCL -> P0.0)
    const struct device *rtc_dev = app_rtc_init();
    if (!rtc_dev) {
        printk("failed to initialize RTC device\n");
        return 0;
    }

	// retrieve the current timestamp from the RTC device 
	struct tm new_time = {
        .tm_sec = 0,
        .tm_min = 0,
        .tm_hour = 12,
        .tm_mday = 30,
        .tm_mon = 3,   // April (0-based)
        .tm_year = 125, // 2025 (since 1900)
        .tm_wday = 3    // Wednesday
    };

	printk("Geophone Measurement Simulation and Process Information\n");
	
	// start the main loop for data simulation and transmission
	for (int8_t i =0; i < 5; i++) {

		// retrieve the current timestamp from the RTC device 
		if (app_rtc_set_time(rtc_dev, &new_time) == 0) {
			struct tm current_time;
			data.timestamp = app_rtc_get_time(rtc_dev, &current_time);
		} else {
			printk("RTC set time failed\n");
			k_sleep(K_SECONDS(10));
			continue;
		}

		// generate random simulated sensor data
		data.vbat = sys_rand16_get() % 101;            // battery voltage: 0-100
		data.temp = sys_rand16_get() % 201 - 100;      // temperature: -100 to 100
		data.hum = sys_rand16_get() % 101;             // humidity: 0-100
		data.vadc = sys_rand16_get() % 3301;           // ADC voltage: 0-3300 mV

		// add the timestamp to the start of the data buffer
		payload[0] = (data.timestamp >> 24) & 0xFF; // most significant byte
		payload[1] = (data.timestamp >> 16) & 0xFF;
		payload[2] = (data.timestamp >> 8) & 0xFF;
		payload[3] = data.timestamp & 0xFF;        // least significant byte
		
		// encode sensor data into the payload
        payload[4] = (data.vbat >> 8) & 0xFF;
        payload[5] = data.vbat & 0xFF;

        payload[6] = (data.temp >> 8) & 0xFF;
        payload[7] = data.temp & 0xFF;

        payload[8] = (data.hum >> 8) & 0xFF;
        payload[9] = data.hum & 0xFF;

        payload[10] = (data.vadc >> 8) & 0xFF;
        payload[11] = data.vadc & 0xFF;

		// indicate data transmission with the TX LED
		printk("sending random data...\n");
		gpio_pin_set_dt(&led_tx, 1);

		// send the payload over LoRaWAN (unconfirmed message)
		ret = lorawan_send(LORAWAN_PORT, payload, PAYLOAD_SIZE, LORAWAN_MSG_UNCONFIRMED);
		
		// handle transmission errors
		if (ret == -EAGAIN) {
			printk("LoRaWAN send failed (retry). error: %d\n", ret);
			gpio_pin_set_dt(&led_tx, 0);
			k_sleep(K_SECONDS(10));
			continue;
		}
		
		// handle transmission errors
		if (ret < 0) {
			printk("LoRaWAN send failed. error: %d. retrying\n", ret);
			gpio_pin_set_dt(&led_tx, 0);
        	k_sleep(K_SECONDS(10));
        	continue;
		}

		printk("data sent successfully!\n");
		gpio_pin_set_dt(&led_tx, 0);

		// wait before the next iteration
		k_sleep(DELAY);
	}
	return 0;
}
```

## src/app_flash.c
```c
/*
 * Copyright (c) 2025
 * Regis Rousseau
 * Univ Lyon, INSA Lyon, Inria, CITI, EA3720
 * SPDX-License-Identifier: Apache-2.0
 */

//  ========== include =====================================================================
#include "app_flash.h"

//  ========== app_flash_init ==============================================================
int8_t app_flash_init(struct nvs_fs *fs)
{
//  ========== app_flash_init ==============================================================
int8_t app_flash_init(struct nvs_fs *fs)
{
	struct flash_pages_info info;
	int8_t ret = 0;
	ssize_t size = 0;

	// configure the storage partition in flash memory
	fs->flash_device = NVS_PARTITION_DEVICE;

	// check if the flash device is ready
	if (!device_is_ready(fs->flash_device)) {
		printk("flash device \"%s\" is not ready\n", fs->flash_device->name);
		return 0;
	} else {
		printk("- found device: \"%s\", getting nvs memory\n", fs->flash_device->name);
	}

	// set the offset of the NVS partition in flash memory
	fs->offset = NVS_PARTITION_OFFSET;

	// retrieve information about the flash memory page at the specified offset
	ret = flash_get_page_info_by_offs(fs->flash_device, fs->offset, &info);
	if (ret) {
		printk("unable to get page info. error: %d\n", ret);
		return ret;
	}
	
	// set the sector size for the NVS partition
	fs->sector_size = info.size;

	// validate the sector size
	if (!fs->sector_size) {
		printk("invalid sector size\n");
		return -1;
	}
	printk("sector size: %d\n", info.size);

	// mount the NVS partition on the flash memory
	fs->sector_count = 4U;		 // number of sectors allocated to the NVS partition
	ret = nvs_mount(fs);
	if (ret) {
		printk("flash to initialize flash memory. error: %d\n", ret);
		return 0;
	}

	return 0;
}

//  ========== app_flash_init_param ========================================================
int8_t app_flash_init_param(struct nvs_fs *fs, uint16_t id, void *data)
{
	int8_t ret = 0;

	// try to read the data associated with the given ID from NVS
	ret = nvs_read(fs, id, data, sizeof(data));
	if (ret > 0) {
		// data exists: print the ID and the associated address
		printk("ID: %d, address: %s\n", id, data);
	} else {
		// no data found: log the absence and write the provided data to NVS
		printk("no address found, adding %s at id %d\n", data, id);
		(void)nvs_write(fs, id, data, sizeof(data));	
	}
	return 0;
}
```

## src/app_flash.h
```c
/*
 * Copyright (c) 2025
 * Regis Rousseau
 * Univ Lyon, INSA Lyon, Inria, CITI, EA3720
 * SPDX-License-Identifier: Apache-2.0
 */

#ifndef APP_FLASH_H
#define APP_FLASH_H

//  ========== includes ====================================================================
#include <zephyr/kernel.h>
#include <zephyr/device.h>
#include <zephyr/devicetree.h>
#include <zephyr/drivers/flash.h>
#include <zephyr/storage/flash_map.h>
#include <zephyr/fs/nvs.h>

//  ========== defines =====================================================================
#define NVS_PARTITION			storage_partition
#define NVS_PARTITION_DEVICE	FIXED_PARTITION_DEVICE(NVS_PARTITION)
#define NVS_PARTITION_OFFSET	FIXED_PARTITION_OFFSET(NVS_PARTITION)  
#define NVS_DEVNONCE_ID			0                     

//  ========== prototypes ==================================================================
int8_t app_flash_init(struct nvs_fs *fs);
int8_t app_flash_init_param(struct nvs_fs *fs, uint16_t id, void *data);

#endif /* APP_FLASH_H */
```

## src/app_lorawan.c
```c
/*
 * Copyright (c) 2025
 * Regis Rousseau
 * Univ Lyon, INSA Lyon, Inria, CITI, EA3720
 * SPDX-License-Identifier: Apache-2.0
 */

//  ========== includes ====================================================================
#include "app_lorawan.h"
#include "app_nvs.h"

//  ========== globals =====================================================================
static const struct gpio_dt_spec led_tx = GPIO_DT_SPEC_GET(LED_TX, gpios);
static const struct gpio_dt_spec led_rx = GPIO_DT_SPEC_GET(LED_RX, gpios);

// downlink callback
static void dl_callback(uint8_t port, bool data_pending, int16_t rssi, int8_t snr, uint8_t len, const uint8_t *data)
{
	printk("downlink data received: ");
    for(int8_t i=0; i < len; i++) {
		printk("%02X ", data[i]);
	}
    printk("\n");
	printk("port: %d, pending: %d, RSSI: %ddB, SNR: %dBm\n", port, data_pending, rssi, snr);
}

// ADR change callback
static void lorwan_datarate_changed(enum lorawan_datarate dr)
{
	uint8_t unused, max_size;

	lorawan_get_payload_sizes(&unused, &max_size);
	printk("new datarate: DR_%d, max payload: %d\n", dr, max_size);
}

//  ========== app_loarwan_init ============================================================
int8_t app_lorawan_init(void)
{
	struct lorawan_join_config join_cfg;
	static struct nvs_fs fs;
	uint16_t dev_nonce = 0u;

	int8_t itr = 1;
	uint8_t dev_eui[] 	= LORAWAN_DEV_EUI;
	uint8_t join_eui[]	= LORAWAN_JOIN_EUI;
	uint8_t app_key[]	= LORAWAN_APP_KEY;

	// initialize non-volatile storage (NVS) and read the current dev_nonce value
	app_nvs_init(&fs);
	app_nvs_init_param(&fs, NVS_DEVNONCE_ID, &dev_nonce);

	printk("starting LoRaWAN node initialization\n");

    // retrieve the LoRa SX1276 device
	const struct device *lora_dev = DEVICE_DT_GET(DT_ALIAS(lora0));
	if (!device_is_ready(lora_dev)) {
		printk("%s: LoRaWAN device not ready\n", lora_dev->name);
		return 0;
	}

	printk("starting LoRaWAN stack\n");

    // set the region (Europe)
	int8_t ret = lorawan_set_region(LORAWAN_REGION_EU868);
	if (ret < 0) {
		printk("failed to start LoRaWAN stack. error: %d\n", ret);
		return 0;
	}

	// indicate device activity by toggling the transmission LED
	gpio_pin_set_dt(&led_tx, 1);

	// start the LoRaWAN stack
	ret = lorawan_start();
	if (ret < 0) {
		printk("failed to start LoRaWAN stack. error: %d\n", ret);
		return 0;
	} else {
			// allow some time for the stack to stabilize
			k_sleep(K_MSEC(500));
	}

	// enable Adaptive Data Rate (ADR) to optimize communication settings
    lorawan_enable_adr(true);

    // register downlink and data rate change callbacks for receiving messages and updates
	struct lorawan_downlink_cb downlink_cb = {
		.port = LW_RECV_PORT_ANY,
		.cb = dl_callback
	};
	lorawan_register_downlink_callback(&downlink_cb);
	lorawan_register_dr_changed_callback(lorwan_datarate_changed);  

	// configuration of lorawan network using OTAA
    join_cfg.mode = LORAWAN_ACT_OTAA;
	join_cfg.dev_eui = dev_eui;
	join_cfg.otaa.join_eui = join_eui;
	join_cfg.otaa.app_key = app_key;
	join_cfg.otaa.nwk_key = app_key;
	join_cfg.otaa.dev_nonce = dev_nonce;

	// attempt to join the LoRaWAN network using OTAA
	do {
		printk("attempting to join LoRaWAN network using OTAA. Dev nonce: %d, attempt: %d\n", join_cfg.otaa.dev_nonce, itr++);

		// indicate receiving activity by toggling the reception LED
		gpio_pin_set_dt(&led_rx, 1);

		ret = lorawan_join(&join_cfg);
		if (ret < 0) {
			if (ret == -ETIMEDOUT) {
				printk("join request timed out. retrying...\n");
			} else {
				printk("failed to join network. error: %d\n", ret);
			}
		} else {
			printk("successfully joined LoRaWAN network using OTAA.\n");
		}

		// increment and save the device nonce in NVS for the next attempt
		dev_nonce++;
		join_cfg.otaa.dev_nonce = dev_nonce;

		// save value away in Non-Volatile Storage.
		ssize_t err = nvs_write(&fs, NVS_DEVNONCE_ID, &dev_nonce, sizeof(dev_nonce));
		if (err < 0) {
			printk("NVS: failed to write dev_nonce (id %d). error: %d\n", NVS_DEVNONCE_ID, err);
		}

		// if the join attempt failed, wait before retrying
		if (ret < 0) {
			// if failed, wait before re-trying.
			k_sleep(K_MSEC(10000));
		}
	} while (ret != 0 && itr < MAX_JOIN_ATTEMPTS);

	// turn off LEDs to indicate the end of the process
	gpio_pin_set_dt(&led_tx, 0);
	gpio_pin_set_dt(&led_rx, 0);
	
    return 1;
}

  
    
```

## src/app_lorawan.h
```c
/*
 * Copyright (c) 2025
 * Regis Rousseau
 * Univ Lyon, INSA Lyon, Inria, CITI, EA3720
 * SPDX-License-Identifier: Apache-2.0
 */

#ifndef APP_LORAWAN_H
#define APP_LORAWAN_H

//  ========== includes ====================================================================
#include <zephyr/kernel.h>
#include <zephyr/device.h>
#include <zephyr/devicetree.h>
#include <zephyr/drivers/gpio.h>
#include <zephyr/drivers/lora.h>
#include <zephyr/lorawan/lorawan.h>
#include <zephyr/random/random.h>

//  ========== defines =====================================================================
#define LED_TX                  DT_ALIAS(ledtx)     // declared in device tree 
#define LED_RX                  DT_ALIAS(ledrx)     // declared in device tree
#define DELAY 			        K_MINUTES(1)   
#define PAYLOAD_SIZE            12

// customize based on network configuration
#define LORAWAN_DEV_EUI			{ 0x70, 0xB3, 0xD5, 0x7E, 0xD0, 0x06, 0x21, 0xA5 }
#define LORAWAN_JOIN_EUI		{ 0x00, 0x00, 0x00, 0x00, 0x00, 0x00, 0x00, 0x00 }
#define LORAWAN_APP_KEY			{ 0xC7, 0x32, 0x0F, 0x37, 0xFF, 0x62, 0xE0, 0xA8, 0x4E, 0x94, 0xC1, 0x9C, 0x27, 0x2B, 0xFA, 0x4C }
#define LORAWAN_PORT            2       // application port
#define MAX_JOIN_ATTEMPTS       10      // limiting join attempts

//  ========== prototypes ==================================================================
int8_t app_lorawan_init(void);

#endif /* APP_LORAWAN_H */
```

## src/app_nvs.c
```c
/*
 * Copyright (c) 2025
 * Regis Rousseau
 * Univ Lyon, INSA Lyon, Inria, CITI, EA3720
 * SPDX-License-Identifier: Apache-2.0
 */

//  ========== include =====================================================================
#include "app_nvs.h"

//  ========== app_flash_init ==============================================================
int8_t app_nvs_init(struct nvs_fs *fs)
{
	struct flash_pages_info info;
	int8_t ret = 0;
	ssize_t size = 0;

	// configure the storage partition in flash memory
	fs->flash_device = NVS_PARTITION_DEVICE;

	// check if the flash device is ready
	if (!device_is_ready(fs->flash_device)) {
		printk("flash device \"%s\" is not ready\n", fs->flash_device->name);
		return 0;
	} else {
		printk("- found device: \"%s\", getting nvs memory\n", fs->flash_device->name);
	}

	// set the offset of the NVS partition in flash memory
	fs->offset = NVS_PARTITION_OFFSET;

	// retrieve information about the flash memory page at the specified offset
	ret = flash_get_page_info_by_offs(fs->flash_device, fs->offset, &info);
	if (ret) {
		printk("unable to get page info. error: %d\n", ret);
		return ret;
	}
	
	// set the sector size for the NVS partition
	fs->sector_size = info.size;

	// validate the sector size
	if (!fs->sector_size) {
		printk("invalid sector size\n");
		return -1;
	}
	printk("sector size: %d\n", info.size);

	// mount the NVS partition on the flash memory
	fs->sector_count = 4U;		 // number of sectors allocated to the NVS partition
	ret = nvs_mount(fs);
	if (ret) {
		printk("flash to initialize flash memory. error: %d\n", ret);
		return 0;
	}

	return 0;
}

//  ========== app_flash_init_param ========================================================
int8_t app_nvs_init_param(struct nvs_fs *fs, uint16_t id, void *data)
{
	int8_t ret = 0;

	// try to read the data associated with the given ID from NVS
	ret = nvs_read(fs, id, data, sizeof(data));
	if (ret > 0) {
		// data exists: print the ID and the associated address
		printk("ID: %d, address: %s\n", id, data);
	} else {
		// no data found: log the absence and write the provided data to NVS
		printk("no address found, adding %s at id %d\n", data, id);
		(void)nvs_write(fs, id, data, sizeof(data));	
	}
	return 0;
}
```

## src/app_nvs.h
```c
/*
 * Copyright (c) 2025
 * Regis Rousseau
 * Univ Lyon, INSA Lyon, Inria, CITI, EA3720
 * SPDX-License-Identifier: Apache-2.0
 */

#ifndef APP_NVS_H
#define APP_NVS_H

//  ========== includes ====================================================================
#include <zephyr/kernel.h>
#include <zephyr/device.h>
#include <zephyr/devicetree.h>
#include <zephyr/drivers/flash.h>
#include <zephyr/storage/flash_map.h>
#include <zephyr/fs/nvs.h>

//  ========== defines =====================================================================
#define NVS_PARTITION			storage_partition
#define NVS_PARTITION_DEVICE	FIXED_PARTITION_DEVICE(NVS_PARTITION)
#define NVS_PARTITION_OFFSET	FIXED_PARTITION_OFFSET(NVS_PARTITION)  
#define NVS_DEVNONCE_ID			0                     

//  ========== prototypes ==================================================================
int8_t app_nvs_init(struct nvs_fs *fs);
int8_t app_nvs_init_param(struct nvs_fs *fs, uint16_t id, void *data);

#endif /* APP_NVS_H */
```

## src/app_rtc.c
```c
/*
 * Copyright (c) 2025
 * Regis Rousseau
 * Univ Lyon, INSA Lyon, Inria, CITI, EA3720
 * SPDX-License-Identifier: Apache-2.0
 */

//  ========== includes ====================================================================
#include "app_rtc.h"

//  ========== bcd_to_decimal ==============================================================
uint8_t bcd_to_decimal(uint8_t val) {
    return ((val / 16) * 10) + (val % 16);
}

//  ========== decimal_to_bcd ==============================================================
uint8_t decimal_to_bcd(uint8_t val) {
    return ((val / 10) << 4) | (val % 10);
}

//  ========== app_rtc_set_time ============================================================
int8_t app_rtc_set_time(const struct device *i2c_dev, const struct tm *date_time)
{
    uint8_t time_data[7] = {
        decimal_to_bcd(date_time->tm_sec),       // seconds
        decimal_to_bcd(date_time->tm_min),       // minutes
        decimal_to_bcd(date_time->tm_hour),      // hours
        decimal_to_bcd(date_time->tm_wday),      // day of the week (1 = Sunday)
        decimal_to_bcd(date_time->tm_mday),      // day of the month
        decimal_to_bcd(date_time->tm_mon + 1),   // month (1-based)
        decimal_to_bcd(date_time->tm_year - 100) // year (since 2000)
    };

    int ret = i2c_burst_write(i2c_dev, DS3231_I2C_ADDR, 0x00, time_data, 7);
    if (ret < 0) {
        printk("failed to set RTC time. error %d\n", ret);
    }

    printk("RTC time set successfully\n");
    return 0;
}

//  ========== app_rtc_get_time ============================================================
int32_t app_rtc_get_time(const struct device *i2c_dev, struct tm *date_time)
{
    uint8_t rtc_data[7];
    int ret = i2c_burst_read(i2c_dev, DS3231_I2C_ADDR, 0x00, rtc_data, sizeof(rtc_data));
    if (ret < 0) {
        printk("failed to read RTC registers. error: %d", ret);
        return ret;
    }

    date_time->tm_sec = bcd_to_decimal(rtc_data[0]);
    date_time->tm_min = bcd_to_decimal(rtc_data[1]);
    date_time->tm_hour = bcd_to_decimal(rtc_data[2]);
    date_time->tm_wday = bcd_to_decimal(rtc_data[3]);
    date_time->tm_mday = bcd_to_decimal(rtc_data[4]);
    date_time->tm_mon = bcd_to_decimal(rtc_data[5]) - 1; // Months are 0-based
    date_time->tm_year = bcd_to_decimal(rtc_data[6]) + 100; // Years since 1900

    int32_t timestamp = (int32_t)mktime(date_time);
    printk("current date and time: %04d-%02d-%02d %02d:%02d:%02d",
            date_time->tm_year + 1900, date_time->tm_mon + 1, date_time->tm_mday,
            date_time->tm_hour, date_time->tm_min, date_time->tm_sec);
    printk("unix timestamp: %d", timestamp);
    return timestamp;
}

//  ========== app_rtc_init ================================================================
const struct device *app_rtc_init(void)
{
    const struct device *rtc_dev = DEVICE_DT_GET_ONE(maxim_ds3231);
    if (!rtc_dev) {
        printk("no RTC device found");
        return NULL;
    }

    if (!device_is_ready(rtc_dev)) {
        printk("RTC device is not ready");
        return NULL;
    }

    printk("RTC device \"%s\" initialized successfully", rtc_dev->name);
    return rtc_dev;
}
```

## src/app_rtc.h
```c
/*
 * Copyright (c) 2025
 * Regis Rousseau
 * Univ Lyon, INSA Lyon, Inria, CITI, EA3720
 * SPDX-License-Identifier: Apache-2.0
 */

#ifndef APP_RTC_H
#define APP_RTC_H

//  ========== includes ====================================================================
#include <zephyr/kernel.h>
#include <zephyr/device.h>
#include <zephyr/devicetree.h>
#include <zephyr/drivers/rtc.h>
#include <zephyr/drivers/rtc/maxim_ds3231.h>

//  ========== prototypes ==================================================================
int8_t app_rtc_init(const struct device *dev);
int32_t app_rtc_get_time(const struct device *dev);

#endif /* APP_RTC_H */
```
